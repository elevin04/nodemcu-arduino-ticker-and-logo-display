/**************************************************************************
  This is an example for our Monochrome OLEDs based on SSD1306 drivers

  Pick one up today in the adafruit shop!
  ------> http://www.adafruit.com/category/63_98

  This example is for a 128x32 pixel display using I2C to communicate
  3 pins are required to interface (two I2C and one reset).

  Adafruit invests time and resources providing this open
  source code, please support Adafruit and open-source
  hardware by purchasing products from Adafruit!

  Written by Limor Fried/Ladyada for Adafruit Industries,
  with contributions from the open source community.
  BSD license, check license.txt for more information
  All text above, and the splash screen below must be
  included in any redistribution.
 **************************************************************************/

#include <SPI.h>
#include <Wire.h>
#include <Adafruit_GFX.h>
#include <Adafruit_SSD1306.h>
#include <TM1637Display.h>
#include <ESP8266HTTPClient.h>
#include <ESP8266WiFiMulti.h>
#include <ESP8266HTTPClient.h>
#include <ESP8266WiFi.h>
#include <ArduinoJson.h>


String ssid = "INSERT-SSID-HERE";
String password = "INSERT-PASSWORD-HERE";

String api = "api.coingecko.com/api/v3";
const String url = "INSERT-THINGSPEAK-API-HERE";

const uint8_t fingerprint[20] = {0x40, 0xaf, 0x00, 0x6b, 0xec, 0x90, 0x22, 0x41, 0x8e, 0xa3, 0xad, 0xfa, 0x1a, 0xe8, 0x25, 0x41, 0x1d, 0x1a, 0x54, 0xb3};


ESP8266WiFiMulti WiFiMulti;

#define SCREEN_WIDTH 128 // OLED display width, in pixels
#define SCREEN_HEIGHT 32 // OLED display height, in pixels

// Declaration for an SSD1306 display connected to I2C (SDA, SCL pins)
#define OLED_RESET     -1 // Reset pin # (or -1 if sharing Arduino reset pin)
Adafruit_SSD1306 display(SCREEN_WIDTH, SCREEN_HEIGHT, &Wire, OLED_RESET);

// 4 Digit Display GPIO
const int CLK = 3; //Set the CLK pin connection to the display
const int DIO = 1; //Set the DIO pin connection to the display

TM1637Display digits(CLK, DIO); //set up the 4-Digit Display.

#define LOGO_HEIGHT   32
#define LOGO_WIDTH    128

const unsigned char eth [] = {
  0x00, 0x60, 0x00, 0x00, 0x00, 0x00, 0x00, 0x00, 0x00, 0x00, 0x00, 0x00, 0x00, 0x00, 0x00, 0x00,
  0x00, 0x60, 0x00, 0x00, 0x00, 0x00, 0x00, 0x00, 0x00, 0x00, 0x00, 0x00, 0x00, 0x00, 0x00, 0x00,
  0x00, 0xF0, 0x00, 0x00, 0x00, 0x00, 0x00, 0x00, 0x00, 0x00, 0x00, 0x00, 0x00, 0x00, 0x00, 0x00,
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  0x00, 0x60, 0x00, 0x00, 0x00, 0x00, 0x00, 0x00, 0x00, 0x00, 0x00, 0x00, 0x00, 0x00, 0x00, 0x00
};



void setup() {
  Serial.begin(9600);

  Serial.println("MAN");

  // SSD1306_SWITCHCAPVCC = generate display voltage from 3.3V internally
  if (!display.begin(SSD1306_SWITCHCAPVCC, 0x3C)) { // Address 0x3C for 128x32
    Serial.println(F("SSD1306 allocation failed"));
    for (;;); // Don't proceed, loop forever
  }

  Serial.println("dafuq");

  digits.setBrightness(0x0a); //set the diplay to maximum brightness

  // Show initial display buffer contents on the screen --
  // the library initializes this with an Adafruit splash screen.
  display.display();
  delay(2000); // Pause for 2 seconds

  Serial.println("bruhhhh");

  // Clear the buffer
  display.clearDisplay();

  drawEth();    // Draw a small bitmap image

  WiFi.mode(WIFI_STA);
  WiFiMulti.addAP("TeamLevine", "9782649717");

  Serial.println("end of setup");
  
  delay(1000);

}

void loop() {
  // wait for WiFi connection
  if((WiFiMulti.run() == WL_CONNECTED)) {
        
        HTTPClient http;
        if (http.begin(url)) {  // http
          // start connection and send HTTP header
          int httpCode = http.GET();

          // httpCode will be negative on error
          if (httpCode > 0) {
            // HTTP header has been send and Server response header has been handled
            Serial.println("nice");
    
            // file found at server
            if (httpCode == HTTP_CODE_OK || httpCode == HTTP_CODE_MOVED_PERMANENTLY) {
              String payload = http.getString();
              Serial.println(payload.toInt());
              digits.clear();
              delay(500);
              digits.showNumberDec(payload.toInt());
            }
          } else {
            Serial.println("rip fredo");
          }

          http.end();
        } else {
      Serial.println("fuck");
    }
  }

  Serial.println("Wait 10s before next round...");
  delay(30000);
}

void drawEth(void) {
  display.clearDisplay();

  display.drawBitmap(
    (display.width()  - LOGO_WIDTH ) / 2,
    (display.height() - LOGO_HEIGHT) / 2,
    eth, LOGO_WIDTH, LOGO_HEIGHT, 1);
  display.display();
  delay(1000);
}
